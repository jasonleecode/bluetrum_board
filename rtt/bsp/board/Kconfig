## rtt/bsp/board/Kconfig
```kconfig
menu "Hardware Drivers Config"

menuconfig SOC_AB32VG1
    bool "SOC_AB32VG1"
    select PKG_USING_BLUETRUM_SDK
    default y

menu "Onboard Peripheral Drivers"

    config BSP_USING_KEYS
        bool "Three board keys: PF1, PF0, PA2"
        select RT_USING_PIN
        select RT_USING_DEVICE_OPS
        select RT_USING_MUTEX
        depends on !BSP_USING_SPI1 || (BSP_SPI1_MAPPING != 1 && BSP_SPI1_MAPPING != 5)
        depends on !BSP_USING_I2S || BSP_I2S_MAPPING != 0
        depends on !BSP_USING_LPWM2_G3
        default n
        help
            keys0 event stream with 30 ms debounce and 800 ms long press.
            Scanned by the existing main thread; no extra key thread or IRQ.

    config BSP_USING_LED_BREATH
        bool "S2 toggles the red PE1 breathing LED"
        depends on BSP_USING_KEYS
        depends on !BSP_USING_I2S || BSP_I2S_MAPPING != 1
        select BSP_USING_PWM
        select BSP_USING_T5_PWM
        select BSP_USING_T5_PWM0
        default n
        help
            Off at boot. S2 DOWN toggles a three-second brightness cycle.
            Timer5 PWM0 at 4 kHz, P1 pins 3-4 connected; no new thread.

    config BSP_USING_RADIO_APP
        bool "S2 / infrared radio application"
        depends on BSP_USING_KEYS && BSP_USING_LED_BREATH && BSP_USING_IRRX && BSP_USING_FMRX
        default n
        help
            S2 toggles FM and breathing together (97.4 MHz, 15% at start).
            NEC remote up/down changes volume 5%, left/right tunes 100 kHz.
            Runs in main, with no additional thread or audio buffer.

    menuconfig BSP_USING_AUDIO
        bool "Enable Audio Device"
        select RT_USING_AUDIO
        default n

        if BSP_USING_AUDIO
            config BSP_USING_AUDIO_PLAY
            bool "Enable Audio Play"
            default y
        endif

    config BSP_USING_I2S
        bool "Enable experimental hardware I2S output from sound0"
        select BSP_USING_AUDIO
        select BSP_USING_AUDIO_PLAY
        default n
        help
            Recovered from the AB5300-family SDK. Master, 16-bit stereo,
            normal I2S, MCLK=256fs, audio SRC output at 44.1/48 kHz.
            PCM written to sound0 also drives I2S; FM does not drive I2S.
            Register/pin compatibility checked, requires board validation.
            External codec configuration, RX and DMA are not implemented.
    if BSP_USING_I2S
        config BSP_I2S_MAPPING
            int "I2S group: 0=PA0..4, 1=PE0..4 (DI/DO/BCLK/LRCLK/MCLK)"
            range 0 1
            default 1
    endif

    config BSP_USING_AUDEC
        bool "AUDEC MP3 hardware back end (44.1 kHz mono/stereo)"
        select RT_USING_MUTEX
        select RT_USING_DEVICE_OPS
        default n
        help
            Registers audec0, with exclusive stream ownership and bounded
            synchronous PCM output. Requires software-parsed MP3 granules,
            not compressed MP3 bytes. Supports mono, independent stereo and
            M/S joint stereo, without intensity stereo. Reserves 0x54000..0x56fff and selects
            the SRAM linker layout. The integrated Bluetooth layout reserves
            this area separately from resident code and heap. See MP3.md.

    config BSP_USING_FMRX
        bool "Enable recovered FM receiver with internal DAC playback"
        select BSP_USING_AUDIO
        select BSP_USING_AUDIO_PLAY
        default n
        help
            Registers fm0 and the fmrx shell command. Manual tuning,
            volume, stop and a 100 ms DAC synchronization worker.
            Exclusively shares the DAC with sound0. No automatic scan/RDS.
            Includes a DAC test tone and raw RSSI/register diagnostics.
            Uses the SRAM linker layout. Requires CTIA earphones as antenna;
            broadcast reception remains unverified on the current board.

    config BSP_USING_TFCARD
        bool "Native TF card block device (experimental)"
        depends on !BSP_USING_SDIO && !BSP_USING_SDCARD && !BSP_USING_T3_PWM0
        depends on !BSP_USING_SPI1 || BSP_SPI1_MAPPING != 3
        depends on !RT_USING_DFS_V2
        select RT_USING_DEVICE_OPS
        select RT_USING_DFS
        select RT_USING_DFS_ELMFAT
        default n
        help
            Reuses the native SD0 1-bit source driver on PB0/PB1/PB2.
            tf probe and tf mount are explicit; no worker, hotplug or autoformat.
            FAT12/16/32 read/write; physical card validation remains pending.

    config BSP_USING_SDCARD
        bool "Enable SDCARD"
        select BSP_USING_SDIO
        default n

    if BSP_USING_SDCARD
    config SDIO_MAX_FREQ
        int "sdio max freq"
        range 240000 24000000
        default 24000000
    endif

    config BSP_USING_BTCTRL
        bool "Enable recovered Bluetooth controller and HCI diagnostics"
        default n
        help
            Uses recovered controller sources, reserved 0x11000 controller RAM,
            a dedicated RTT worker and the btctl shell command. No automatic
            radio start. FM and Bluetooth RF operation are mutually exclusive
            during bring-up. This option does not enable a NimBLE host.

    config BSP_USING_USB_CDC
        bool "Experimental native USB CDC ACM device"
        depends on !RT_USING_CHERRYUSB
        default n
        help
            AB32 DMA controller port and bundled CherryUSB 1.5.2 core/CDC.
            usbcdc start enables a binary echo device on PB3/PB4.
            Uses the native USB connector, not the CH340 programming port.
            Enumeration and physical transfers await board validation.

    config BSP_USING_NIMBLE
        bool "NimBLE Host from rtt/nimble submodule"
        select BSP_USING_BTCTRL
        default n
        help
            RT-Thread NPL and HCI transport to the recovered controller.
            Explicit ble start enables the one-connection test peripheral.

endmenu

menu "On-chip Peripheral Drivers"
    config BSP_USING_PIN_IRQ
        bool "GPIO edge callbacks (optional, deferred to thread)"
        depends on RT_USING_PIN
        select RT_USING_SEMAPHORE
        select RT_USING_MUTEX
        default n
        help
            Per-pin callbacks, shared wakeup circuit demultiplexing and both-edge
            rearming. Allocates the worker on first enable. Board keys use polling
            and do not need this option. Not a high-speed pulse counter.

    menuconfig BSP_USING_SPI1
        bool "Enable hardware SPI1 (experimental, fixed reset timing)"
        select RT_USING_SPI
        select RT_USING_PIN
        default n
        help
            Recovered hardware master, 8-bit MSB, separate TX/RX phases.
            Mode 0 is the API placeholder for SDK reset timing, still
            requiring oscilloscope verification. Other modes and full
            duplex are rejected. No software SPI is used.
    if BSP_USING_SPI1
        config BSP_SPI1_MAPPING
            int "SPI1 DI/CLK/DO: 1=PA2/3/4, 2=PA5/6/7, 3=PB0/1/2, 4=PE5/6/7, 5=PF0/1/2, 6=PE4/3/2"
            range 1 6
            default 6
            help
                G6 is documented in the chip pin table and avoids the unified
                board's keys/UART/TF/IR. It shares PE2/PE3 with the IIC header
                and PE2/PE3/PE4 with I2S G2: these cannot run together.
        config BSP_SPI1_TIMEOUT_MS
            int "SPI byte timeout (ms)"
            range 1 1000
            default 100
    endif

    menuconfig BSP_USING_UART
        bool "Enable UART"
        if BSP_USING_UART
            config BSP_USING_UART0
                bool "Enable UART0"
                select RT_USING_SERIAL
                default y
            if BSP_USING_UART0
                config BSP_UART0_FIFO_SIZE
                    int "BSP_UART0_FIFO_SIZE"
                    range 5 255
                    default 10
            endif

            config BSP_USING_UART1
                bool "Enable UART1"
                select RT_USING_SERIAL
                default n
            if BSP_USING_UART1
                config BSP_UART1_FIFO_SIZE
                    int "BSP_UART1_FIFO_SIZE"
                    range 5 255
                    default 10
            endif

            config BSP_USING_UART2
                bool "Enable UART2"
                select RT_USING_SERIAL
                default n
            if BSP_USING_UART2
                config BSP_UART2_FIFO_SIZE
                    int "BSP_UART2_FIFO_SIZE"
                    range 5 255
                    default 10
            endif
        endif

    config BSP_USING_SDIO
        bool "Enable SDIO"
        select RT_USING_SDIO
        select RT_USING_DFS
        select RT_USING_DFS_ELMFAT
        default n

    menuconfig BSP_USING_I2C1
        bool "Enable I2C1 BUS (software simulation)"
        default n
        select RT_USING_I2C
        select RT_USING_I2C_BITOPS
        select RT_USING_PIN
        if BSP_USING_I2C1
            comment "Notice: PE3 --> 16; PE2 --> 15"
            config BSP_I2C1_SCL_PIN
                int "I2C1 scl pin number"
                range 1 27
                default 16
            config BSP_I2C1_SDA_PIN
                int "I2C1 sda pin number"
                range 1 27
                default 15
        endif

    menuconfig BSP_USING_PWM
        bool "Enable PWM"
        default n
        select RT_USING_PWM
        select RT_USING_MUTEX
        if BSP_USING_PWM
        menuconfig BSP_USING_T3_PWM
            bool "Enable Timer3 PWM"
            default n
            if BSP_USING_T3_PWM
                config BSP_USING_T3_PWM0
                    bool "Enable Timer3 PWM0 (PB0)(Confict with SD card)"
                    default n
            endif

        menuconfig BSP_USING_T4_PWM
            bool "Enable Timer4 PWM"
            default n
            if BSP_USING_T4_PWM
                config BSP_USING_T4_PWM1
                    bool "Enable Timer4 PWM1 (PA6)(Confit with uart0 rx)"
                    default y
            endif

        menuconfig BSP_USING_T5_PWM
            bool "Enable Timer5 PWM"
            default y
            if BSP_USING_T5_PWM
                config BSP_USING_T5_PWM0
                    bool "Enable Timer5 PWM0 (PE1)"
                    default y
            endif

        menuconfig BSP_USING_LPWM0
            bool "Enable LPWM0"
            default n
            if BSP_USING_LPWM0
                comment "G1, G2 and G3 are mutually exclusive"
                config BSP_USING_LPWM0_G1
                    bool "Enable LPWM0 G1 (PE4)"
                    default y
            endif

        menuconfig BSP_USING_LPWM1
            bool "Enable LPWM1"
            default n
            if BSP_USING_LPWM1
                comment "G1, G2 and G3 are mutually exclusive"
                config BSP_USING_LPWM1_G3
                    bool "Enable LPWM1 G3 (PA1)"
                    default y
            endif

        menuconfig BSP_USING_LPWM2
            bool "Enable LPWM2"
            default n
            if BSP_USING_LPWM2
                comment "G1, G2 and G3 are mutually exclusive"
                config BSP_USING_LPWM2_G2
                    bool "Enable LPWM2 G2 (PE0)"
                    default y
                config BSP_USING_LPWM2_G3
                    bool "Enable LPWM2 G3 (PA2)"
                    default n
            endif
        endif

    config BSP_USING_WDT
        bool "Enable Watchdog Timer"
        select RT_USING_WDT
        default n

    menuconfig BSP_USING_TIM
        bool "Enable timer"
        default n
        select RT_USING_HWTIMER
        if BSP_USING_TIM
            config BSP_USING_TIM1
                bool "Enable TIM1"
                default y

            config BSP_USING_TIM2
                bool "Enable TIM2"
                default n

            config BSP_USING_TIM3
                bool "Enable TIM3"
                depends on !BSP_USING_T3_PWM && !BSP_USING_IRRX
                default n

            config BSP_USING_TIM4
                bool "Enable TIM4"
                depends on !BSP_USING_T4_PWM
                default n

            config BSP_USING_TIM5
                bool "Enable TIM5"
                depends on !BSP_USING_T5_PWM
                default n
        endif

    menuconfig BSP_USING_ONCHIP_RTC
        bool "Enable RTC"
        select RT_USING_RTC
        select RT_USING_MUTEX
        default n
        help
            Native 32-bit IRTC seconds, with bounded bridge transactions.
            First power-up time is unset until rtcctl set or set_timestamp().
            Alarm/second IRQs and power-down wakeup are not implemented.
        if BSP_USING_ONCHIP_RTC
            config RTC_USING_INTERNAL_CLK
                bool "Using internal clock RTC"
                default y
                help
                    Use the RTC internal RC oscillator (untrimmed accuracy).
                    Disable only with an appropriate external 32.768 kHz source;
                    V02 schematic does not populate a 32.768 kHz crystal.
        endif

    config BSP_USING_POWER
        bool "Power control, retained-clock sleep and reset-on-wake shutdown"
        select BSP_USING_ONCHIP_RTC
        select RT_USING_DEVICE_OPS
        default n
        help
            power0 provides raw PWKEY/VUSB state, RTC-domain wake flags,
            PWKEY input/filter and WK/VUSB wake enable controls.
            Shares the bounded native RTC bridge and mutex. Captures raw boot
            wake flags without clearing them. Manual sleep retains PLL/RAM,
            uses RTC second wake and compensates the paused tick (1..2 s).
            Power-off wakes through normal ROM/RTT boot. Active BT/audio/FM/
            USB/TF block entry. No PLL-off deep sleep or automatic RTT PM
            callbacks. Off/wake and current consumption need hardware tests.

    menuconfig BSP_USING_ADC
        bool "Enable ADC"
        default n
        select RT_USING_ADC
        if BSP_USING_ADC
            config BSP_USING_ADC0
                bool "Enable ADC0"
                default y
        endif

    menuconfig BSP_USING_IRRX
        bool "Enable native NEC infrared receiver on PE6"
        depends on !BSP_USING_T3_PWM
        depends on !BSP_USING_SPI1 || BSP_SPI1_MAPPING != 4
        select RT_USING_DEVICE_OPS
        default n
        help
            Registers ir0 and irrx start/stop/status/read/watch. Explicit start,
            static event queue, no worker. NEC/extended NEC hardware decoding;
            physical reception still requires validation with a remote.
        if BSP_USING_IRRX
            config BSP_USING_IRRX_HW
                bool
                default y
        endif

    config BSP_USING_ON_CHIP_FLASH
        bool "Enable on-chip FLASH"
        select RT_USING_FAL
        default n
endmenu


endmenu
```

## rtt/components/drivers/audio/Kconfig
```kconfig
config RT_USING_AUDIO
    bool "Using Audio device drivers"
    default n

    if RT_USING_AUDIO
        config RT_AUDIO_USING_LAZY_INIT
            bool "Initialize audio buffers on first device open"
            default n
            help
                Registration only publishes the device. rt_device_open() (or
                an explicit rt_device_init()) allocates PCM buffers later.
                Allocation failure is reported to the caller and can be retried.

        config RT_AUDIO_REPLAY_MP_BLOCK_SIZE
            int "Replay memory pool block size"
            default 4096

        config RT_AUDIO_REPLAY_MP_BLOCK_COUNT
            int "Replay memory pool block count"
            default 2

        config RT_AUDIO_RECORD_PIPE_SIZE
            int "Record pipe size"
            default 2048

    endif
```
